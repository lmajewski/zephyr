## drivers/ethernet/Kconfig.dsa
```kconfig
# Distributed Switch Architecture [DSA] configuration options

# Copyright (c) 2020 DENX Software Engineering GmbH
#               Lukasz Majewski <lukma@denx.de>
# SPDX-License-Identifier: Apache-2.0

menuconfig NET_DSA
	bool "Distributed Switch Architecture support"
	depends on NETWORKING
	help
	  Enable Distributed Switch Architecture support. For now it
	  only supports Kinetics ENET driver.

if NET_DSA

config DSA_KSZ8794
	bool "Enable support for KSZ8794"
	help
	  Add support for KSZ8794 DSA device driver.

config DSA_KSZ8794_TAIL_TAGGING
	bool "Enable support for tail tagging on KSZ8794"
	help
	  Add support for tail tagging on KSZ8794 DSA device.

endif # NET_DSA
```

## dts/bindings/dsa/microchip,ksz8794.yaml
```yaml
# Copyright (c) 2020 DENX Software Engineering GmbH
# SPDX-License-Identifier: Apache-2.0

description: |
    KSZ8794 ethernet switch with SPI interface

compatible: "microchip,ksz8794"

include: [spi-device.yaml]
properties:
    dsa-master-port:
       type: phandle
       required: false
       description: Phandle to master port.
    dsa-slave-ports:
       type: int
       required: false
       description: Number of slave ports on the switch
    spi-cpha:
       type: boolean
       required: false
       description: |
          Set to indicate phase starts with asserted half-phase (CPHA=1).
          For this driver using this property requires also using cpol.
    spi-cpol:
        type: boolean
        required: false
        description: |
          Set to indicate clock leading edge is falling (CPOL=1).
          For this driver using this property requires also using cpha.

child-binding:
    description: Praperties of slave port
    properties:
        label:
            type: string
            required: true
        local-mac-address:
            type: uint8-array
            required: false
            description: |
                Specifies the MAC address that was assigned to the port
```
