## drivers/ethernet/Kconfig.oa_tc6
```kconfig
# Copyright (c) 2023 DENX Software Engineering GmbH
# SPDX-License-Identifier: Apache-2.0

menuconfig OA_TC6
	bool "OPEN Alliance Technical Committee 6 (TC6) support"
	default n
	depends on ETH_LAN865X
	help
	  The LAN865X is a low power, 10BASE-T1S transceiver compliant with
	  the IEEE® 802.3cg-2019™ Ethernet standard for long reach, 10
	  Mbps single pair Ethernet (SPE).

	  Featuring an integrated media access control (MAC) and a PHY,
	  the LAN865X enables direct connectivity with a variety of controllers
	  via a serial peripheral inter-face (SPI).

if OA_TC6

config OA_TC6_RXTX_THREAD_STACK_SIZE
	int "Stack size for a thread that processes RXTX transmission"
	default 1024
	help
	  Size of the stack used for internal thread which is ran to
	  send and receive SPI data.

config OA_TC6_RXTX_THREAD_PRIO
	int "Priority for internal function to handle transmission"
	default 5
	help
	  Priority level for internal thread which is ran for OA TC6
	  SPI data transmission.

config OA_TC6_TX_POOL_SIZE
	int "Size of pool for OA TC6 TX SPI transfers"
	default 4
	help
	  Size of network buffer pool required for outgoing SPI data
	  transmission.

endif # OA_TC6
```

## samples/net/sockets/echo_server/boards/nucleo_g431rb.conf
```kconfig
# Generic networking options
CONFIG_NETWORKING=y
CONFIG_NET_UDP=y
CONFIG_NET_TCP=n
CONFIG_NET_IPV6=n
CONFIG_NET_IPV4=y
CONFIG_NET_SOCKETS=y
CONFIG_NET_SOCKETS_POSIX_NAMES=y
CONFIG_POSIX_MAX_FDS=4
CONFIG_NET_CONNECTION_MANAGER=y

# Kernel options
CONFIG_MAIN_STACK_SIZE=2048
CONFIG_ENTROPY_GENERATOR=y
CONFIG_TEST_RANDOM_GENERATOR=y
CONFIG_INIT_STACKS=y

# Logging
CONFIG_NET_LOG=n
CONFIG_LOG=n
CONFIG_NET_STATISTICS=n

# Network buffers
CONFIG_NET_PKT_RX_COUNT=4
CONFIG_NET_PKT_TX_COUNT=4
CONFIG_NET_BUF_RX_COUNT=32
CONFIG_NET_BUF_TX_COUNT=32
CONFIG_NET_CONTEXT_NET_PKT_POOL=y

# IP address options
CONFIG_NET_MAX_CONTEXTS=2
CONFIG_NET_MAX_CONN=2

# Network shell
CONFIG_NET_SHELL=n
CONFIG_SHELL=n

# Network application options and configuration
CONFIG_NET_CONFIG_SETTINGS=y
CONFIG_NET_CONFIG_NEED_IPV4=y
CONFIG_NET_CONFIG_MY_IPV4_ADDR="192.168.3.3"
CONFIG_NET_CONFIG_PEER_IPV4_ADDR="192.168.3.1"

# How many client can connect to echo-server simultaneously
CONFIG_NET_SAMPLE_NUM_HANDLERS=1

# LAN865x T1S driver specific
CONFIG_NET_L2_ETHERNET=y
# CONFIG_NET_PROMISCUOUS_MODE=y
CONFIG_ETH_LAN865X=y
CONFIG_NET_BUF_DATA_SIZE=64

# For setting MAC address
CONFIG_NET_L2_ETHERNET_MGMT=y

# Debug options
CONFIG_DEBUG_THREAD_INFO=y
```
