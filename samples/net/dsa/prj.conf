## CMakeLists.txt
```
# SPDX-License-Identifier: Apache-2.0

cmake_minimum_required(VERSION 3.13.1)

find_package(Zephyr HINTS $ENV{ZEPHYR_BASE})
project(dsa)

target_sources(app PRIVATE src/main.c src/udpload.c src/ethsupervision.c)
```

## sample.yaml
```
common:
  harness: net
  tags: net dsa
sample:
  description: Test DSA functionality
  name: DSA sample app
tests:
  sample.net.dsa:
    platform_allow: ip_k66f
    depends_on: netif
```

## prj.conf
```kconfig
CONFIG_NETWORKING=y
CONFIG_NET_LOG=y
CONFIG_NET_IPV6=y
CONFIG_NET_IPV4=y
CONFIG_NET_DHCPV4=n
CONFIG_NET_UDP=y
CONFIG_NET_TCP=y
CONFIG_NET_STATISTICS=y
CONFIG_NET_STATISTICS_USER_API=y

CONFIG_TEST_RANDOM_GENERATOR=y

CONFIG_NET_PKT_RX_COUNT=64
CONFIG_NET_PKT_TX_COUNT=64
CONFIG_NET_BUF_RX_COUNT=64
CONFIG_NET_BUF_TX_COUNT=64
CONFIG_NET_IF_UNICAST_IPV6_ADDR_COUNT=5
CONFIG_NET_IF_MCAST_IPV6_ADDR_COUNT=5
CONFIG_NET_IF_UNICAST_IPV4_ADDR_COUNT=1
CONFIG_NET_MAX_CONTEXTS=4

CONFIG_INIT_STACKS=y
CONFIG_PRINTK=y
CONFIG_NET_SHELL=y

# DSA support
CONFIG_NET_DSA=y
CONFIG_DSA_KSZ8794_TAIL_TAGGING=y

# Ethernet is needed for LLDP
CONFIG_NET_L2_ETHERNET=y

CONFIG_NET_CONFIG_NEED_IPV6=y
CONFIG_NET_CONFIG_NEED_IPV4=y
CONFIG_NET_CONFIG_SETTINGS=y

# Logging
CONFIG_LOG=y
CONFIG_NET_DSA_LOG_LEVEL_INF=y

# Support for lan1..3 as RAW_SOCKETS
CONFIG_NET_SOCKETS=y
CONFIG_NET_SOCKETS_PACKET=y
CONFIG_NET_SOCKETS_POSIX_NAMES=y

# How many traffic classes to enable
CONFIG_NET_TC_TX_COUNT=6
CONFIG_NET_TC_RX_COUNT=4
CONFIG_NET_CONFIG_INIT_TIMEOUT=10

CONFIG_NEWLIB_LIBC=y

CONFIG_NET_IF_MAX_IPV4_COUNT=4
CONFIG_NET_IF_MAX_IPV6_COUNT=4
CONFIG_NET_CONFIG_MY_IPV4_ADDR="192.168.0.2"
CONFIG_NET_CONFIG_MY_IPV4_GW="192.168.0.1"

CONFIG_ETH_MCUX_PROMISCUOUS_MODE=y

# Add RTT SHELL support -> Instead of LOG_BACKEND_RTT
# Shell can be used to test the DSA operation with e.g.
# 'net ping -I3 192.168.0.1'
CONFIG_SHELL=y
CONFIG_SHELL_BACKEND_RTT=y
CONFIG_SHELL_BACKEND_SERIAL=n
CONFIG_LOG_BACKEND_RTT=n
```

## src/main.c
```c
/*
 * Copyright (c) 2020 DENX Software Engineering GmbH
 *
 * SPDX-License-Identifier: Apache-2.0
 */

#include <logging/log.h>
LOG_MODULE_REGISTER(net_dsa_lldp_sample, CONFIG_NET_DSA_LOG_LEVEL);

#include <net/dsa.h>
#include "main.h"

static void dsa_slave_port_setup(struct net_if *iface, struct ud *ifaces)
{
	struct dsa_context *context = net_if_get_device(iface)->data;

	if (ifaces->lan1 == NULL) {
		ifaces->lan1 = context->iface_slave[1];
	}

	if (ifaces->lan2 == NULL) {
		ifaces->lan2 = context->iface_slave[2];
	}

	if (ifaces->lan3 == NULL) {
		ifaces->lan3 = context->iface_slave[3];
	}
}

static void iface_cb(struct net_if *iface, void *user_data)
{

	struct ud *ifaces = user_data;

	if (net_if_l2(iface) != &NET_L2_GET_NAME(ETHERNET)) {
		return;
	}

	if (net_eth_get_hw_capabilities(iface) & ETHERNET_DSA_MASTER_PORT) {
		if (ifaces->master == NULL) {
			ifaces->master = iface;
			return;
		}
	}

	if (net_eth_get_hw_capabilities(iface) & ETHERNET_DSA_SLAVE_PORT) {
		dsa_slave_port_setup(iface, ifaces);
	}
}

static const uint8_t eth_filter_l2_addr_base[][6] = {
	/* MAC address of other device - for filtering testing */
	{ 0x01, 0x80, 0xc2, 0x00, 0x00, 0x03 }
};

enum net_verdict dsa_ll_addr_switch_cb(struct net_if *iface,
				       struct net_pkt *pkt)
{
	struct net_eth_hdr *hdr = NET_ETH_HDR(pkt);
	struct net_linkaddr lladst;

	net_pkt_cursor_init(pkt);
	lladst.len = sizeof(hdr->dst.addr);
	lladst.addr = &hdr->dst.addr[0];

	/*
	 * Pass packet to lan1..3 when matching one from
	 * check_ll_ether_addr table
	 */
	if (check_ll_ether_addr(lladst.addr, &eth_filter_l2_addr_base[0][0])) {
		return 1;
	}

	return 0;
}

int start_slave_port_packet_socket(struct net_if *iface,
				   struct instance_data *pd)
{
	struct sockaddr_ll dst;
	int ret;

	pd->sock = socket(AF_PACKET, SOCK_RAW, ETH_P_ALL);
	if (pd->sock < 0) {
		LOG_ERR("Failed to create RAW socket : %d", errno);
		return -errno;
	}

	dst.sll_ifindex = net_if_get_by_iface(iface);
	dst.sll_family = AF_PACKET;

	ret = bind(pd->sock, (const struct sockaddr *)&dst,
		   sizeof(struct sockaddr_ll));
	if (ret < 0) {
		LOG_ERR("Failed to bind packet socket : %d", errno);
		return -errno;
	}

	return 0;
}

struct ud ifaces;
static int init_dsa_ports(void)
{
	uint8_t tbl_buf[8];
	/*
	 * Set static table to forward LLDP protocol packets
	 * to master port.
	 */
	dsa_set_mac_table_entry(&eth_filter_l2_addr_base[0][0], BIT(4), 0, 0);
	dsa_get_mac_table_entry(tbl_buf, 0);

	LOG_INF("DSA static MAC address table entry [%d]:", 0);
	LOG_INF("0x%x 0x%x 0x%x 0x%x 0x%x 0x%x 0x%x 0x%x",
		tbl_buf[7], tbl_buf[6], tbl_buf[5], tbl_buf[4],
		tbl_buf[3], tbl_buf[2], tbl_buf[1], tbl_buf[0]);

	(void)memset(&ifaces, 0, sizeof(ifaces));
	net_if_foreach(iface_cb, &ifaces);

	return 0;
}

void main(void)
{
	init_dsa_ports();

	LOG_INF("DSA ports init - OK");
}
```

## src/dsa_lldp.c
```c
/*
 * Copyright (c) 2020 DENX Software Engineering GmbH
 *
 * SPDX-License-Identifier: Apache-2.0
 */

#include <stdlib.h>
#include <stdio.h>
#include <string.h>

#include <net/socket.h>
#include <net/net_core.h>
#include <net/net_l2.h>
#include <net/net_if.h>
#include <net/socket.h>
#include <net/ethernet.h>
#include <net/lldp.h>
#include <errno.h>

#include <logging/log.h>
#include <malloc.h>
#include "main.h"

/* Loglevel of dsa_lldp function */
LOG_MODULE_REGISTER(sample_dsa_lldp, LOG_LEVEL_DBG);

#define LLDP_SYSTEM_NAME_SIZE 24
#define LLDP_ETHER_TYPE 0x88CC
#define DSA_BUF_SIZ 128
int dsa_lldp_send(struct net_if *iface, struct instance_data *pd,
		  uint16_t lan, int src_port, int origin_port, int cmd,
		  struct eth_addr *origin_addr)
{
	int ret, len;
	char buffer[DSA_BUF_SIZ], sys_name[LLDP_SYSTEM_NAME_SIZE];
	struct sockaddr_ll dst;
	struct ethernet_context *ctx = net_if_l2_data(iface);
	struct net_eth_hdr *eth_hdr = (struct net_eth_hdr *) buffer;
	uint8_t *p = &buffer[sizeof(struct net_eth_hdr)];
	uint8_t *pb = p;

	lan = ctx->dsa_port_idx;

	dst.sll_ifindex = net_if_get_by_iface(iface);
	/* Construct the Ethernet header */
	memset(buffer, 0, DSA_BUF_SIZ);
	/* Ethernet header */
	/* Take MAC address assigned to LAN port */
	memcpy(eth_hdr->src.addr, net_if_get_link_addr(iface)->addr, ETH_ALEN);
	eth_hdr->dst.addr[0] = MCAST_DEST_MAC0;
	eth_hdr->dst.addr[1] = MCAST_DEST_MAC1;
	eth_hdr->dst.addr[2] = MCAST_DEST_MAC2;
	eth_hdr->dst.addr[3] = MCAST_DEST_MAC3;
	eth_hdr->dst.addr[4] = MCAST_DEST_MAC4;
	eth_hdr->dst.addr[5] = MCAST_DEST_MAC5;

	/* Ethertype field */
	eth_hdr->type = htons(LLDP_ETHER_TYPE);

	/* LLDP packet data */
	/* Chasis ID */
	dsa_buf_write_be16((LLDP_TLV_CHASSIS_ID << 9) | (ETH_ALEN + 1), &p);
	*p++ = 4; /* subtype */
	memcpy(p, net_if_get_link_addr(iface)->addr, ETH_ALEN);
	p += ETH_ALEN;

	/* PORT ID */
	dsa_buf_write_be16((LLDP_TLV_PORT_ID << 9) | (ETH_ALEN + 1), &p);
	*p++ = 3; /* subtype */
	memcpy(p, net_if_get_link_addr(iface)->addr, ETH_ALEN);
	p += ETH_ALEN;

	/* TTL ID */
	dsa_buf_write_be16((LLDP_TLV_TTL << 9) | 2, &p);
	*p++ = 0; /* TTL field is 2 bytes long */
	*p++ = 120;

	/* SYSTEM NAME */
	memset(sys_name, 0, sizeof(sys_name));
	sprintf(sys_name, "ip_k66f LAN:%d", lan);
	dsa_buf_write_be16((LLDP_TLV_SYSTEM_NAME << 9) | strlen(sys_name), &p);
	memcpy(p, sys_name, strlen(sys_name));
	p += strlen(sys_name);

	len = sizeof(struct net_eth_hdr) + (p - pb);
	ret = sendto(pd->sock, buffer, len, 0, (const struct sockaddr *)&dst,
		     sizeof(struct sockaddr_ll));
	if (ret < 0) {
		LOG_ERR("Failed to send, errno %d", errno);
	}

	return 0;
}

void dsa_lldp_print_info(uint8_t *lldp_p, uint8_t lanid)
{
	uint16_t tl, length;
	uint8_t type, subtype;
	uint8_t *p, t1, t2;
	char *t;

	LOG_INF("LLDP pkt recv -> lan%d", lanid);
	do {
		/* In-buffer data is stored as big endian */
		t1 = *lldp_p++;
		t2 = *lldp_p++;
		tl = (uint16_t) t1 << 8 | t2;

		/* Get type and length */
		type = tl >> 9;
		length = tl & 0x1FF;

		switch (type) {
		case LLDP_TLV_CHASSIS_ID:
		case LLDP_TLV_PORT_ID:
			/* Extract subtype */
			subtype = *lldp_p++;
			length--;
			break;
		}

		p = lldp_p;

		switch (type) {
		case LLDP_TLV_END_LLDPDU:
			return;
		case LLDP_TLV_CHASSIS_ID:
			LOG_INF("\tCHASIS ID:\t%02x:%02x:%02x:%02x:%02x:%02x",
				p[0], p[1], p[2], p[3], p[4], p[5]);
			break;
		case LLDP_TLV_PORT_ID:
			LOG_INF("\tPORT ID:\t%02x:%02x:%02x:%02x:%02x:%02x",
				p[0], p[1], p[2], p[3], p[4], p[5]);
			break;
		case LLDP_TLV_TTL:
			/* TTL field has 2 bytes in BE */
			LOG_INF("\tTTL:\t\t%ds", (uint16_t) p[0] << 8 | p[1]);
			break;
		case LLDP_TLV_SYSTEM_NAME:
			t = malloc(length+1);
			if (t == NULL) {
				LOG_ERR("Cannot allocate memory on k_malloc");
				break;
			}
			memset(t, 0, length+1);
			memcpy(t, p, length);
			LOG_INF("\tSYSTEM NAME:\t%s", log_strdup(t));
			free(t);
			break;
		}
		lldp_p += length;
	} while (1);
}

int dsa_lldp_recv(struct net_if *iface, struct instance_data *pd,
		  uint16_t *lan, int *origin_port,
		  struct eth_addr *origin_addr)
{
	struct ethernet_context *ctx = net_if_l2_data(iface);
	struct net_eth_hdr *eth_hdr =
		(struct net_eth_hdr *) pd->recv_buffer;
	uint8_t *lldp_p = &pd->recv_buffer[sizeof(struct net_eth_hdr)];
	int received;

	*lan = ctx->dsa_port_idx;

	/* Receive data */
	received = recv(pd->sock, pd->recv_buffer,
			sizeof(pd->recv_buffer), 0);
	if (received < 0) {
		LOG_ERR("RAW : recv error %d", errno);
		return -1;
	}

	if (eth_hdr->type != 0xCC88) {
		LOG_ERR("Wrong LLDP packet type value [0x%x]", eth_hdr->type);
		return -1;
	}

	dsa_lldp_print_info(lldp_p, *lan);
	return 0;
}

DSA_THREAD(1, dsa_lldp_recv, dsa_lldp_send)
DSA_THREAD(2, dsa_lldp_recv, dsa_lldp_send)
DSA_THREAD(3, dsa_lldp_recv, dsa_lldp_send)
```

## src/ethsupervision.c
```c
/*
 * Copyright (c) 2020 Securiton
 */

#include <stdlib.h>
#include <stdio.h>
#include <string.h>

#include <net/socket.h>
#include <net/net_core.h>
#include <net/net_l2.h>
#include <net/net_if.h>
#include <net/socket.h>
#include <net/ethernet.h>
#include <errno.h>

#include <logging/log.h>
#include "main.h"

// Loglevel of ethsupervision function
LOG_MODULE_REGISTER(ethsupervision, LOG_LEVEL_DBG);

/* in Securisafe 0x8267 is used */
#define PRIVATE_ETHER_TYPE 0x8267

#define ETH_DISCOVER_REVISION 1

struct eth_discover {
  uint8_t  cmd;                 /* COMMAND */
  uint8_t  revision;            /* protocol revision */
  uint16_t seq;                 /* sequence number */
  uint16_t cksum;               /* checksum */
  uint16_t src_port;            /* src port */
  uint16_t origin_port;         /* origin port */
  struct eth_addr origin_addr;   /* origin hardware address */
  uint8_t  padding[PACKET_LEN-16]; /* padding for 128 Byte data */
};
#define BUF_SIZ (sizeof(struct eth_discover) + sizeof (struct net_eth_hdr))

static uint16_t in_cksum(uint16_t *buf, int sz) {
	int nleft = sz;
	int sum = 0;
	uint16_t *w = buf;
	uint16_t ans = 0;

	while (nleft > 1) {
		sum += *w++;
		nleft -= 2;
	}

	if (nleft == 1) {
		*(unsigned char *) (&ans) = *(unsigned char *) w;
		sum += ans;
	}

	sum = (sum >> 16) + (sum & 0xFFFF);
	sum += (sum >> 16);
	ans = ~sum;
	return ans;
}

int ethSupervision_send(struct net_if *iface, struct instance_data *pd,
			uint16_t seq, int src_port, int origin_port, int cmd,
			struct eth_addr* origin_addr)
{
	/* Send back data */
	int ret;
	char buffer[BUF_SIZ];
	struct sockaddr_ll dst;
	struct dsa_context *context;
	struct net_eth_hdr *eth_hdr = (struct net_eth_hdr *) buffer;
	struct eth_discover *eth_discover = (struct eth_discover*)
		&buffer[sizeof(struct net_eth_hdr)];

	dst.sll_ifindex = net_if_get_by_iface(iface);
	context = net_if_get_device(iface)->data;
	/* Construct the Ethernet header */
	memset(buffer, 0, BUF_SIZ);
	/* Ethernet header */
	/* take mac addr from master (HW) */
	memcpy(eth_hdr->src.addr, net_if_get_link_addr(ifaces.master)->addr,
	       ETH_ALEN);
	eth_hdr->dst.addr[0] = MCAST_DEST_MAC0;
	eth_hdr->dst.addr[1] = MCAST_DEST_MAC1;
	eth_hdr->dst.addr[2] = MCAST_DEST_MAC2;
	eth_hdr->dst.addr[3] = MCAST_DEST_MAC3;
	eth_hdr->dst.addr[4] = MCAST_DEST_MAC4;
	eth_hdr->dst.addr[5] = MCAST_DEST_MAC5;

	/* Ethertype field */
	eth_hdr->type = htons(PRIVATE_ETHER_TYPE);

	/* Discover Packet data */
	eth_discover->cmd = cmd;
	eth_discover->revision = ETH_DISCOVER_REVISION;
	eth_discover->seq                 = htons(seq);
	eth_discover->src_port            = htons(src_port);
	eth_discover->origin_port         = htons(origin_port);

	memcpy(eth_discover->origin_addr.addr, origin_addr, ETH_ALEN);

	eth_discover->cksum = in_cksum((uint16_t*)eth_discover,
				       sizeof(struct eth_discover));

	ret = sendto(pd->sock, buffer, sizeof(buffer), 0,
		     (const struct sockaddr *)&dst,
		     sizeof(struct sockaddr_ll));
	if (ret < 0) {
		LOG_ERR("Failed to send, errno %d", errno);
	}

	return 0;
}

int ethSupervision_recv(struct net_if *iface, struct instance_data *pd,
			uint16_t *seq, int *origin_port,
			struct eth_addr* origin_addr)
{
	struct net_eth_hdr *eth_hdr =
		(struct net_eth_hdr *) pd->recv_buffer;
	struct eth_discover *eth_discover =
		(struct eth_discover *)
		&pd->recv_buffer[sizeof(struct net_eth_hdr)];
	uint16_t cksum = 0;
	int received;

	/* Receive data */
	received = recv(pd->sock, pd->recv_buffer,
			sizeof(pd->recv_buffer), 0);
	if (received < 0) {
		LOG_ERR("RAW : recv error %d", errno);
		return -1;
	}

	if (received <
	    (int)sizeof(struct eth_discover) +
	    (int)sizeof(struct net_eth_hdr)) {
		LOG_ERR("[ERROR] too short packet %d bytes received\n",
			received);
		return -1;
	}

	cksum = eth_discover->cksum;
	eth_discover->cksum = 0;
	uint16_t cksum_recalc  = in_cksum((uint16_t*)eth_discover,
				       sizeof(struct eth_discover));
	if (cksum != cksum_recalc) {
		LOG_ERR("[ERROR] cksum missmatch 0x%04x / 0x%04x\n",
			cksum, cksum_recalc);
		return -1;
	}

	if (eth_discover->cmd == CMD_DISCOVER) {
		LOG_INF("rx discover on=%s seq=%3u origin=%d %02x:%02x:%02x:%02x:%02x:%02x",
			log_strdup(pd->if_name),
			ntohs(eth_discover->seq),
			ntohs(eth_discover->origin_port),
			eth_discover->origin_addr.addr[0],
			eth_discover->origin_addr.addr[1],
			eth_discover->origin_addr.addr[2],
			eth_discover->origin_addr.addr[3],
			eth_discover->origin_addr.addr[4],
			eth_discover->origin_addr.addr[5]);
		LOG_INF("src=%02x:%02x:%02x:%02x:%02x:%02x",
			eth_hdr->src.addr[0],
			eth_hdr->src.addr[1],
			eth_hdr->src.addr[2],
			eth_hdr->src.addr[3],
			eth_hdr->src.addr[4],
			eth_hdr->src.addr[5]);
		LOG_INF("dst=%02x:%02x:%02x:%02x:%02x:%02x",
			eth_hdr->dst.addr[0],
			eth_hdr->dst.addr[1],
			eth_hdr->dst.addr[2],
			eth_hdr->dst.addr[3],
			eth_hdr->dst.addr[4],
			eth_hdr->dst.addr[5]);
	}

	*seq = ntohs(eth_discover->seq);
	*origin_port = ntohs(eth_discover->origin_port);
	memcpy(origin_addr, eth_discover->origin_addr.addr,
	       sizeof(struct eth_addr) );

	return 0;
}

DSA_THREAD(1, ethSupervision_recv, ethSupervision_send)
DSA_THREAD(2, ethSupervision_recv, ethSupervision_send)
DSA_THREAD(3, ethSupervision_recv, ethSupervision_send)
```

## src/udpload.c
```c
#include <stdlib.h>
#include <stdio.h>
#include <string.h>

#include <sys_clock.h>
#include <net/socket.h>
#include <posix/unistd.h>
#include <errno.h>

#include <logging/log.h>


// Loglevel of main function
LOG_MODULE_REGISTER(udpload, LOG_LEVEL_DBG);


//Setup and start udpload
#define UDPLOAD_STACK_SIZE 2048
#define UDPLOAD_PRIORITY      5 /* >0 is preemptable */

static void udpload_thread(void* t1, void* t2, void* t3);
K_THREAD_DEFINE(udpload_tid, UDPLOAD_STACK_SIZE,
                udpload_thread, NULL, NULL, NULL,
                UDPLOAD_PRIORITY, 0, 6000);

#define UDP_PORT 4888 

#define MAX_BUFFERSIZE 4000

#define GENERR 1
#define SUCCESS 0

#define ETH_HDR_LEN 14
#define IP_HDR_LEN 20
#define UDP_HDR_LEN 8
#define PKT_HDR_LEN (ETH_HDR_LEN + IP_HDR_LEN + UDP_HDR_LEN)

#define MAX_CLIENTS 8

#define RANDOM_DATA_PATTERN

typedef struct {
   uint32_t      s_addr;    /* source address */
   unsigned int  exp_seq;   /* next expected seq */
   unsigned int  rx_total;  /* total rx packets */
   unsigned int  tx_error;  /* total tx errors */
   unsigned int  seq_error; /* total tx errors */
   unsigned int  len_err;   /* total len errors */
   unsigned int  re_xmit;   /* Pkts re transmitted */
   unsigned int  pld_error; /* total bit errors in payload */
} ClientData;

unsigned long getMicroSeconds()
{
  return (unsigned long) k_uptime_get();
}

int isCliPrintEligible (unsigned int *prev_time)
{
  int retval = 1;
#if 0
  struct timespec ts;
  clock_gettime(CLOCK_REALTIME, &ts);
  if ((ts.tv_sec - *prev_time) < 60)
  {
    retval = 0;
  }
  *prev_time = ts.tv_sec;
#endif
  return retval;
}



// This function receives "requests" from multiple clients, replies them
// with the packet received and displays statistics.
int srv()
{
  struct sockaddr_in server_addr;
  struct sockaddr_in client_addr;
  socklen_t alen = sizeof(client_addr);

  int  sd = 0; 
  char *buf = 0;

  ClientData client[MAX_CLIENTS+1];

  int  retval  = 0;
  unsigned int  rx_seq  = 0; 
  unsigned int  rx_of   = 0;
  unsigned int  rx_src  = 0;
  unsigned int  rx_dest = 0;
  unsigned int  rx_error= 0;
  unsigned int  rx_len  = 0;
  unsigned int  i       = 0;
  unsigned int  t       = 0;
  unsigned int  rx_len_err = 0;
  unsigned int  bytes_rcvd = 0;
  unsigned int  prev_recv_err_ts = 0;
  unsigned int  prev_send_err_ts = 0;

#ifdef RANDOM_DATA_PATTERN
  LOG_INF("Server: use RANDOM DATA PATTERN");
#else
  LOG_INF("Server: use NULL DATA PATTERN");
#endif

  buf = (char *) malloc (MAX_BUFFERSIZE);
  if (0 == buf)
  {
    LOG_ERR("Server: Unable to allocate memory");
  }
 
  for (i=0; i <= MAX_CLIENTS; i++)
  {
    client[i].s_addr    = 0;
    client[i].exp_seq   = 1;
    client[i].rx_total  = 0;
    client[i].tx_error  = 0;
    client[i].seq_error = 0;
    client[i].len_err   = 0;
    client[i].re_xmit   = 0;
    client[i].pld_error = 0;
  }

  sd = socket (AF_INET, SOCK_DGRAM, IPPROTO_UDP);

  memset(&server_addr, 0, sizeof(server_addr));
  server_addr.sin_family   =  AF_INET;
  server_addr.sin_port = htons(UDP_PORT);
  server_addr.sin_addr.s_addr = htonl(INADDR_ANY);

  retval = bind (sd, (struct sockaddr*)&server_addr,sizeof(server_addr));

  if (0 != retval) 
  {
    LOG_ERR("Server: Failed to bind port name");
  }

  while (1) 
  {
    memset(buf, 0, MAX_BUFFERSIZE); 
    retval = recvfrom(sd,buf, MAX_BUFFERSIZE, 0, (struct sockaddr*)&client_addr, &alen);
    //LOG_INF("Server: recvfrom len %d", retval);

    if (0 >= retval) 
    {
      if (1 == isCliPrintEligible(&prev_recv_err_ts))
        LOG_ERR("Server: Unexpected receive %d (%d)", retval, errno);
    }
    else
    {
      bytes_rcvd = retval + PKT_HDR_LEN;
      sscanf(buf, "UPi s=%d d=%d q=%d o=%d z=%d\n",
          &rx_src, &rx_dest, &rx_seq, &rx_of, &rx_len);
      rx_src = MAX_CLIENTS+1;
      for (int i=0; (i < MAX_CLIENTS) && (rx_src > MAX_CLIENTS); i++) {
        //LOG_INF("%d 0x%08x 0x%08x", i, client[i].s_addr, client_addr.sin_addr.s_addr);
        if (client[i].s_addr == client_addr.sin_addr.s_addr) {
          //char ipaddr[INET_ADDRSTRLEN];
          //inet_ntop(AF_INET, &(client_addr.sin_addr), ipaddr, INET_ADDRSTRLEN);
          //LOG_INF("Server: found addr %s for client %d", log_strdup(ipaddr), i);
          rx_src = i;
        } else if (client[i].s_addr == 0) {
          char ipaddr[INET_ADDRSTRLEN];
          inet_ntop(AF_INET, &(client_addr.sin_addr), ipaddr, INET_ADDRSTRLEN);
          LOG_ERR("Server: register addr %s for client %d",  log_strdup(ipaddr), i);
          rx_src = i;
          client[i].s_addr = client_addr.sin_addr.s_addr;
        }
      }

      if ((rx_src <= MAX_CLIENTS) && (bytes_rcvd == rx_len))
      {
        if (rx_seq == 1)
        {
          client[rx_src].exp_seq = 1;
          client[rx_src].rx_total= 0;
          client[rx_src].tx_error= 0;
          client[rx_src].seq_error=0;
          client[rx_src].len_err = 0;
          client[rx_src].pld_error=0;
          LOG_INF("Server: Rx-Msg %10d of %10d from %2d size %5d(test started)",
              client[rx_src].rx_total, rx_of, rx_src, rx_len);
        }

        if (rx_seq == client[rx_src].exp_seq) 
        {  
          client[rx_src].exp_seq++;
          client[rx_src].rx_total++;
#ifdef RANDOM_DATA_PATTERN
          // check payload
          if (retval > (int)strlen(buf)) {
            for (t = strlen(buf)+1; (int)t < retval; t++) {
              if (buf[t] != (char)((t%2) ? t/2 : ~(t/2))) {
                client[rx_src].pld_error++;
                LOG_INF("Server: Rx-Msg %10d of %10d from %2d size %5d (bit error %d %d/%d)",
                client[rx_src].rx_total, rx_of, rx_src, rx_len, t, buf[t], (char)t);
              } 
            }
          }
#endif
          if ((rx_seq%10000)==0) 
          {
            LOG_INF("Server: Rx-Msg %10d of %10d from %2d size %5d"
                "(client-err: seq=%d tx=%d len=%d) (glob-err: rx=%d)",
                client[rx_src].rx_total, rx_of, rx_src, rx_len, 
                client[rx_src].seq_error, client[rx_src].tx_error,
                client[rx_src].len_err, rx_error);
          }

          if (rx_seq == rx_of) 
          {
            LOG_INF("Server: Rx-Msg %10d of %10d from %2d size %5d"
                "(client-err: seq=%d tx=%d len=%d) (glob-err: rx=%d) "
                "bit error=%d)",
                client[rx_src].rx_total, rx_of, rx_src, rx_len,
                client[rx_src].seq_error, client[rx_src].tx_error,
                client[rx_src].len_err, rx_error, client[rx_src].pld_error);

            /* send back remote with the last packet */
            sprintf(buf,"UPi s=%d d=%d q=%d o=%d z=%d e=%d\n", rx_src,
                    rx_dest, rx_seq, rx_of, rx_len, 
                    client[rx_src].seq_error + client[rx_src].tx_error +  
                    client[rx_src].len_err   + rx_error + client[rx_src].pld_error);

            client[rx_src].exp_seq = 1;
            client[rx_src].rx_total= 0;
            client[rx_src].tx_error= 0;
            client[rx_src].seq_error= 0;
            client[rx_src].len_err= 0;
            client[rx_src].pld_error=0;
          }
          

          if (0 > sendto(sd, buf, (rx_len - PKT_HDR_LEN), 0,
                (struct sockaddr*)&client_addr,
                sizeof(client_addr)))
          {
            if (1 == isCliPrintEligible (&prev_send_err_ts))
              LOG_ERR("Server: Failed to send");
          }
          retval = 0;
        } else
        {
          LOG_ERR("Server: Wrong seq nbr %10d instead of %10d from %2d "
                      "size %5d (adjust seq) (client-err: seq=%d tx=%d len=%d)"
                      " (glob-err: rx=%d)",
                      rx_seq, client[rx_src].exp_seq, rx_src, rx_len,
                      client[rx_src].seq_error, client[rx_src].tx_error,
                      client[rx_src].len_err, rx_error);
          client[rx_src].exp_seq=rx_seq+1;
          client[rx_src].seq_error++;
        }
      } 
      else
      {
        if (bytes_rcvd != rx_len)
        {
          rx_len_err++;
          LOG_ERR("Server: Invalid message size received - Expected %d "
                       "Arrived %d", rx_len, bytes_rcvd);
        }
        if (rx_src > MAX_CLIENTS)
        {
          LOG_ERR("Server: Rx-Msg from unexpected source %2d",rx_src);
          rx_error++;
        }
      }
    }
  }
  free(buf);
  close (sd);
  return retval;
}

static void udpload_thread(void* t1, void* t2, void* t3) {
  LOG_INF("create UdpLoad");
  srv();
}
```
